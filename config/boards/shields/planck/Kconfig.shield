## config/boards/shields/planck/Kconfig.shield
```kconfig
config SHIELD_EYESLASH_CENTRAL_DONGLE
		def_bool $(shields_list_contains,eyeslash_central_dongle)
```

## config/west.yml
```yaml
manifest:
  remotes:
    - name: zmk
      url-base: https://github.com/zmkfirmware
    - name: englmaxi
      url-base: https://github.com/englmaxi
    - name: yangxing
      url-base: https://github.com/yangxing844
  projects:
    - name: zmk
      remote: zmk
      revision: main
      import: app/west.yml
    - name: zmk-dongle-display
      remote: englmaxi
      revision: main
  self:
    path: config
```
